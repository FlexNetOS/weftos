## crates/clawft-edge-bench/sdkconfig.defaults
```kconfig
# WeftOS Edge Benchmark — ESP32-S3 SDK config
CONFIG_ESP_WIFI_SSID=""
CONFIG_ESP_WIFI_PASSWORD=""
CONFIG_ESP_WIFI_AUTH_WPA2_PSK=y

# Performance tuning
CONFIG_FREERTOS_HZ=1000
CONFIG_ESP_DEFAULT_CPU_FREQ_MHZ_240=y
CONFIG_ESP_SYSTEM_EVENT_TASK_STACK_SIZE=4096

# Heap
CONFIG_HEAP_POISONING_COMPREHENSIVE=n
CONFIG_HEAP_TRACING_OFF=y

# Logging
CONFIG_LOG_DEFAULT_LEVEL_INFO=y
```
